## CMakeLists.txt
```
#
# Vibamix first-stage bootloader (custom direct-XIP A/B, no MCUboot).
#
# Tiny standalone Zephyr app linked into `bootloader_partition` at 0x0. It picks
# a verified app slot (A/B) from bl_state, CRC-checks its trailer, arms the
# watchdog for trial images, and chain-loads it. Build/flash once over SWD:
#   west build -b vibamix_xiao/nrf54l15/cpuapp -d build/bl firmware/bootloader
#   west flash -d build/bl
#
cmake_minimum_required(VERSION 3.20.0)

# The board lives in the app tree; reuse it. DTS_ROOT also picks up its custom
# dts/bindings (e.g. the epaper node the boot diagnostics drive).
list(APPEND BOARD_ROOT ${CMAKE_CURRENT_SOURCE_DIR}/../vibamix_zephyr)
list(APPEND DTS_ROOT ${CMAKE_CURRENT_SOURCE_DIR}/../vibamix_zephyr)

find_package(Zephyr REQUIRED HINTS $ENV{ZEPHYR_BASE})
project(vbx_bootloader)

target_include_directories(app PRIVATE ${CMAKE_CURRENT_SOURCE_DIR}/../common)

target_sources(app PRIVATE
  src/main.c
  src/epd_min.c
  src/diag.c
  ../common/bl_state.c
)
```

## prj.conf
```kconfig
# Vibamix first-stage bootloader — minimal, fits in the 48K bootloader_partition.

# Link into the partition selected by the DT chosen code-partition (app.overlay
# points it at bootloader_partition).
CONFIG_USE_DT_CODE_PARTITION=y

# Raw flash access for bl_state (the slots themselves are read via XIP pointers).
CONFIG_FLASH=y
CONFIG_FLASH_MAP=y
CONFIG_CRC=y

# Watchdog: armed before chain-loading a trial image so a hung boot resets + reverts.
CONFIG_WATCHDOG=y

# Bring-up console (UART). Cheap to keep; aids debugging the boot decision.
# CONFIG_SERIAL=y
# CONFIG_CONSOLE=y
# CONFIG_UART_CONSOLE=y
# CONFIG_PRINTK=y

# ePaper boot diagnostics: minimal GDEY027T91 driver (epd_min.c) over spi00 + GPIO.
# The board has no usable serial, so on a trial/revert/halt the BL draws the boot
# state to the panel.
CONFIG_GPIO=y
CONFIG_SPI=y

# Keep it small and self-contained: no BT/mesh/C++, no shell/logging subsystem.
CONFIG_SIZE_OPTIMIZATIONS=y
CONFIG_LOG=n
CONFIG_BT=n
CONFIG_BOOT_BANNER=n
```

## app.overlay
```dts
/*
 * Link the bootloader into bootloader_partition (0x0). The board's default
 * code-partition is slot_a (for the app build); override it here.
 */
/ {
	chosen {
		zephyr,code-partition = &bootloader_partition;
	};
};
```

## src/main.c
```c
/*
 * Vibamix first-stage bootloader — custom direct-XIP A/B with CRC + watchdog
 * auto-revert (no MCUboot).
 *
 * Boot decision:
 *   1. Debugger attached  -> jump straight to slot A (the dev/flash-debug path;
 *      the debugger `load`s an unsigned ELF into slot A and we run it as-is).
 *   2. Else pick, from bl_state, the highest-version slot that is `valid`, whose
 *      CRC trailer verifies, and that is `confirmed` OR still has a trial attempt
 *      left. A trial boot bumps its attempt count *before* jumping, so a failed
 *      boot (watchdog/crash reset) is excluded next time -> revert to the other
 *      confirmed slot.
 *   3. If bl_state has nothing usable (e.g. first boot after an SWD flash of slot
 *      A, before the app has confirmed), fall back to scanning slot A for a valid
 *      trailer and booting it as a trial.
 *
 * RRAM is memory-mapped (XIP) at the flash offset, so slot images + trailers are
 * read through plain pointers; only bl_state needs the flash driver.
 */

#include <cmsis_core.h>
#include <string.h>
#include <zephyr/devicetree.h>
#include <zephyr/drivers/watchdog.h>
#include <zephyr/kernel.h>
#include <zephyr/storage/flash_map.h>
#include <zephyr/sys/printk.h>
#include <zephyr/sys/util.h>

#include "bl_state.h"
#include "diag.h"
#include "vbx_img.h"

#define SLOT_A_OFF  DT_REG_ADDR(DT_NODELABEL(slot_a_partition))
#define SLOT_A_SIZE DT_REG_SIZE(DT_NODELABEL(slot_a_partition))
#define SLOT_B_OFF  DT_REG_ADDR(DT_NODELABEL(slot_b_partition))
#define SLOT_B_SIZE DT_REG_SIZE(DT_NODELABEL(slot_b_partition))

struct arm_vector_table {
	uint32_t msp;
	uint32_t reset;
};

static uint32_t slot_off(int slot)
{
	return slot == BL_SLOT_B ? SLOT_B_OFF : SLOT_A_OFF;
}

static uint32_t slot_size(int slot)
{
	return slot == BL_SLOT_B ? SLOT_B_SIZE : SLOT_A_SIZE;
}

static const uint8_t *slot_base(int slot)
{
	/* RRAM is mapped at 0x0, so the flash offset is the XIP address. */
	return (const uint8_t *)(uintptr_t)slot_off(slot);
}

static inline bool debugger_attached(void)
{
	return (DCB->DHCSR & DCB_DHCSR_C_DEBUGEN_Msk) != 0;
}

/* Scan a slot for a self-consistent trailer (magic + image_len == offset + CRC).
 * Used only when bl_state can't tell us image_len. Returns image_len or 0. */
static uint32_t scan_trailer(int slot, uint32_t *out_version)
{
	const uint8_t *base = slot_base(slot);
	uint32_t max = slot_size(slot);

	/* Trailers are 16-byte aligned and at least 16 bytes of image precede them. */
	for (uint32_t len = 16; len + VBX_IMG_TRAILER_SIZE <= max; len += 16) {
		const struct vbx_img_trailer *t =
			(const struct vbx_img_trailer *)(base + len);
		if (t->magic != VBX_IMG_MAGIC || t->image_len != len) {
			continue;
		}
		if (vbx_img_verify(base, len, out_version)) {
			return len;
		}
	}
	return 0;
}

static void boot_slot(int slot) __attribute__((noreturn));
static void boot_slot(int slot)
{
	/* Static so it doesn't live on the stack we are about to abandon. */
	static struct arm_vector_table *vt;

	vt = (struct arm_vector_table *)slot_base(slot);

	printk("bl: booting slot %c (msp=0x%08x reset=0x%08x)\n",
	       slot == BL_SLOT_B ? 'B' : 'A', vt->msp, vt->reset);

	if (IS_ENABLED(CONFIG_SYSTEM_TIMER_HAS_DISABLE_SUPPORT)) {
		sys_clock_disable();
	}

	/* Disable + acknowledge all interrupts (mirror MCUboot cleanup_arm_interrupts). */
	__ISB();
	__disable_irq();
	for (uint8_t i = 0; i < ARRAY_SIZE(NVIC->ICER); i++) {
		NVIC->ICER[i] = 0xFFFFFFFF;
	}
	for (uint8_t i = 0; i < ARRAY_SIZE(NVIC->ICPR); i++) {
		NVIC->ICPR[i] = 0xFFFFFFFF;
	}

	/* Clear the MPU so the app configures it from scratch. */
#if defined(CONFIG_CPU_HAS_ARM_MPU)
	{
		uint32_t n = (MPU->TYPE & MPU_TYPE_DREGION_Msk) >> MPU_TYPE_DREGION_Pos;

		for (uint32_t i = 0; i < n; i++) {
			ARM_MPU_ClrRegion(i);
		}
	}
#endif

	SCB->VTOR = (uint32_t)(uintptr_t)vt;
	__DSB();
	__set_MSP(vt->msp);
	__set_CONTROL(0x00); /* the app reconfigures the core on its own */
	__ISB();

	((void (*)(void))vt->reset)();

	CODE_UNREACHABLE;
}

/* Arm wdt31 so a hung trial boot resets the SoC (-> revert). It keeps running
 * across the jump; the app feeds it after a healthy boot, and it pauses itself
 * in System OFF (WDT_OPT_PAUSE_IN_SLEEP). */
/* Gather the boot facts (live CRC, version, bl_state fields) for the on-ePaper
 * diagnostic screen. Live-verifies each slot's trailer so the panel shows the
 * real CRC pass/fail, independent of what bl_state claims. */
static void build_diag(struct bl_diag *d, const struct bl_state_rec *rec, bool have,
		       int choice, bool trial, const char *reason)
{
	memset(d, 0, sizeof(*d));
	d->have_state = have;
	d->seq = have ? rec->seq : 0;
	d->chosen = choice;
	d->trial = trial;
	d->reason = reason;

	for (int s = 0; s < BL_NUM_SLOTS; s++) {
		const struct bl_slot_meta *m = &rec->slot[s];
		uint32_t ver = 0;
		bool crc = false;

		if (have && m->image_len >= VBX_IMG_TRAILER_SIZE) {
			crc = vbx_img_verify(slot_base(s), m->image_len, &ver);
		}
		d->slot[s].valid = have && m->valid;
		d->slot[s].crc_ok = crc;
		d->slot[s].confirmed = have && m->confirmed;
		d->slot[s].attempts = have ? m->attempts : 0;
		d->slot[s].version = crc ? ver : (have ? m->version : 0);
		d->slot[s].image_len = have ? m->image_len : 0;
	}
}

static void arm_watchdog(void)
{
	const struct device *wdt = DEVICE_DT_GET(DT_ALIAS(watchdog0));
	struct wdt_timeout_cfg cfg = {
		/* Generous: a healthy image confirms in a few seconds, but worst-case
		 * boot-to-confirm (ePaper HW init + bt_enable + mesh/settings) can exceed
		 * 8 s, which used to burn the trial and (with no revert target) brick. */
		.window = { .min = 0U, .max = 30000U },
		.callback = NULL,
		.flags = WDT_FLAG_RESET_SOC,
	};

	if (!device_is_ready(wdt)) {
		printk("bl: watchdog not ready; booting without rollback timer\n");
		return;
	}
	if (wdt_install_timeout(wdt, &cfg) < 0) {
		printk("bl: wdt_install_timeout failed\n");
		return;
	}
	if (wdt_setup(wdt, WDT_OPT_PAUSE_IN_SLEEP | WDT_OPT_PAUSE_HALTED_BY_DBG) < 0) {
		printk("bl: wdt_setup failed\n");
	}
}

int main(void)
{
	printk("\nvbx bootloader\n");

	// if (debugger_attached()) {
	// 	printk("bl: debugger attached -> slot A (dev path)\n");
	// 	boot_slot(BL_SLOT_A);
	// }

	struct bl_state_rec rec;
	bool have = (bl_state_read(&rec) == 0);

	int choice = -1;
	bool choice_trial = false;

	if (have) {
		/* Prefer the not-stale slot (the most recently installed image); a stale
		 * slot stays bootable as a revert/fallback target. Iterating low->high and
		 * only switching to a later slot when it is fresh and the incumbent is
		 * stale yields: prefer not-stale, and on a tie (both stale or both fresh)
		 * keep the lower index -> slot 0 (A). Selection is version-independent so
		 * equal-version A/B bundles install correctly. */
		for (int s = 0; s < BL_NUM_SLOTS; s++) {
			const struct bl_slot_meta *m = &rec.slot[s];
			uint32_t ver = 0;

			if (!m->valid) {
				continue;
			}
			if (!vbx_img_verify(slot_base(s), m->image_len, &ver)) {
				printk("bl: slot %d CRC failed\n", s);
				continue;
			}
			bool bootable = m->confirmed || (m->attempts < BL_MAX_ATTEMPTS);

			if (!bootable) {
				printk("bl: slot %d unconfirmed + out of attempts\n", s);
				continue;
			}
			if (choice < 0 || (!m->stale && rec.slot[choice].stale)) {
				choice = s;
				choice_trial = !m->confirmed;
			}
		}
	}

	/* Only scan as a fallback when bl_state has never recorded slot A (a fresh
	 * SWD flash). Once seeded below, a slot-A image that keeps failing to confirm
	 * is left to the normal attempt logic (it trials once, then we halt) rather
	 * than being re-seeded into an endless retry. */
	if (choice < 0 && (!have || !rec.slot[BL_SLOT_A].valid)) {
		/* First boot after an SWD flash. Find + run slot A by scanning for its
		 * trailer, recording it as a trial. */
		uint32_t ver = 0;
		uint32_t len = scan_trailer(BL_SLOT_A, &ver);

		if (len) {
			printk("bl: no state; slot A trailer found (v%u, %u B), trial boot\n",
			       (unsigned)ver, (unsigned)len);
			bl_state_set_pending(BL_SLOT_A, ver, len);
			choice = BL_SLOT_A;
			choice_trial = true;
		}
	}

	if (choice < 0) {
		/* Last resort before bricking: scan BOTH slots for any CRC-valid image
		 * and trial-boot the highest-version one. This rescues the common OTA
		 * case (good new image, no trailered revert target) — better a slow
		 * retry loop than a dead board. */
		int ls = -1;
		uint32_t ls_ver = 0, ls_len = 0;

		for (int s = 0; s < BL_NUM_SLOTS; s++) {
			uint32_t ver = 0;
			uint32_t len = scan_trailer(s, &ver);

			if (len && (ls < 0 || ver >= ls_ver)) {
				ls = s;
				ls_ver = ver;
				ls_len = len;
			}
		}
		if (ls >= 0) {
			printk("bl: last-resort trial boot of slot %d (v%u, %u B)\n",
			       ls, (unsigned)ls_ver, (unsigned)ls_len);
			bl_state_set_pending(ls, ls_ver, ls_len);
			choice = ls;
			choice_trial = true;
		}
	}

	/* Re-read so the diagnostic screen reflects any set_pending above. */
	have = (bl_state_read(&rec) == 0);

	if (choice < 0) {
		struct bl_diag d;

		build_diag(&d, &rec, have, -1, false, "HALT NO BOOTABLE IMG");
		bl_diag_show(&d);
		printk("bl: no bootable image; halting\n");
		for (;;) {
			k_msleep(1000);
		}
	}

	/* A revert = we picked a confirmed slot while the other slot is a valid but
	 * unconfirmed image (a failed trial we just rolled back from). Draw the diag
	 * on trials, reverts, and halts — but not on a plain healthy boot, so normal
	 * boots aren't slowed by the ~2-4 s ePaper refresh. */
	int other = choice ^ 1;
	bool revert = !choice_trial && have && rec.slot[other].valid &&
		      !rec.slot[other].confirmed;

	if (choice_trial || revert) {
		static char reason[24];
		struct bl_diag d;

		if (choice_trial) {
			strcpy(reason, "TRIAL BOOT");
		} else {
			strcpy(reason, "REVERT TO ");
			size_t l = strlen(reason);

			reason[l] = (char)('A' + choice);
			reason[l + 1] = '\0';
		}
		build_diag(&d, &rec, have, choice, choice_trial, reason);
		/* Before arm_watchdog(): the refresh must not eat the trial's budget. */
		bl_diag_show(&d);
	}

	if (choice_trial) {
		/* Count this trial *before* jumping so a reset-without-confirm reverts. */
		bl_state_inc_attempts(choice);
		arm_watchdog();
	}

	boot_slot(choice);
}
```

## src/diag.c
```c
/*
 * Bootloader ePaper diagnostics — see diag.h.
 *
 * Renders the boot decision + per-slot bl_state into a 1bpp framebuffer with a
 * tiny built-in 5x7 font, then full-refreshes the panel via epd_min. Self
 * contained C (no GUI_Paint, no flash/vbx deps) so it fits the 48 KB bootloader.
 */

#include "diag.h"
#include "epd_min.h"

#include <stdint.h>
#include <string.h>
#include <zephyr/sys/printk.h>

/* Logical drawing space: x across the 176-px axis, y down the 264-px axis. The
 * panel framebuffer is written linearly to RAM 0x24; a pixel (x,y) lands at
 * byte (263-y)*22 + (x>>3), bit 0x80>>(x&7), where bit 1 = white. */
#define EPD_W 176
#define EPD_H 264

static uint8_t fb[EPD_MIN_FB_SIZE];

static void set_black(int x, int y)
{
	if ((unsigned)x >= EPD_W || (unsigned)y >= EPD_H) {
		return;
	}
	unsigned idx = (unsigned)(EPD_H - 1 - y) * 22u + ((unsigned)x >> 3);
	fb[idx] &= ~(0x80u >> (x & 7)); /* clear bit -> black */
}

/* 5x7 font, column-major, bit0 = top row. Covers the glyphs the diagnostics use;
 * unknown chars render blank. Values are the classic 5x7 console font. */
struct glyph { char c; uint8_t col[5]; };

static const struct glyph FONT[] = {
	{' ', {0x00, 0x00, 0x00, 0x00, 0x00}},
	{'!', {0x00, 0x00, 0x5F, 0x00, 0x00}},
	{'#', {0x14, 0x7F, 0x14, 0x7F, 0x14}},
	{'%', {0x23, 0x13, 0x08, 0x64, 0x62}},
	{'(', {0x00, 0x1C, 0x22, 0x41, 0x00}},
	{')', {0x00, 0x41, 0x22, 0x1C, 0x00}},
	{'+', {0x08, 0x08, 0x3E, 0x08, 0x08}},
	{'-', {0x08, 0x08, 0x08, 0x08, 0x08}},
	{'.', {0x00, 0x60, 0x60, 0x00, 0x00}},
	{'/', {0x20, 0x10, 0x08, 0x04, 0x02}},
	{'0', {0x3E, 0x51, 0x49, 0x45, 0x3E}},
	{'1', {0x00, 0x42, 0x7F, 0x40, 0x00}},
	{'2', {0x42, 0x61, 0x51, 0x49, 0x46}},
	{'3', {0x21, 0x41, 0x45, 0x4B, 0x31}},
	{'4', {0x18, 0x14, 0x12, 0x7F, 0x10}},
	{'5', {0x27, 0x45, 0x45, 0x45, 0x39}},
	{'6', {0x3C, 0x4A, 0x49, 0x49, 0x30}},
	{'7', {0x01, 0x71, 0x09, 0x05, 0x03}},
	{'8', {0x36, 0x49, 0x49, 0x49, 0x36}},
	{'9', {0x06, 0x49, 0x49, 0x29, 0x1E}},
	{':', {0x00, 0x36, 0x36, 0x00, 0x00}},
	{'=', {0x14, 0x14, 0x14, 0x14, 0x14}},
	{'>', {0x00, 0x41, 0x22, 0x14, 0x08}},
	{'?', {0x02, 0x01, 0x51, 0x09, 0x06}},
	{'A', {0x7E, 0x11, 0x11, 0x11, 0x7E}},
	{'B', {0x7F, 0x49, 0x49, 0x49, 0x36}},
	{'C', {0x3E, 0x41, 0x41, 0x41, 0x22}},
	{'D', {0x7F, 0x41, 0x41, 0x22, 0x1C}},
	{'E', {0x7F, 0x49, 0x49, 0x49, 0x41}},
	{'F', {0x7F, 0x09, 0x09, 0x09, 0x01}},
	{'G', {0x3E, 0x41, 0x49, 0x49, 0x7A}},
	{'H', {0x7F, 0x08, 0x08, 0x08, 0x7F}},
	{'I', {0x00, 0x41, 0x7F, 0x41, 0x00}},
	{'J', {0x20, 0x40, 0x41, 0x3F, 0x01}},
	{'K', {0x7F, 0x08, 0x14, 0x22, 0x41}},
	{'L', {0x7F, 0x40, 0x40, 0x40, 0x40}},
	{'M', {0x7F, 0x02, 0x0C, 0x02, 0x7F}},
	{'N', {0x7F, 0x04, 0x08, 0x10, 0x7F}},
	{'O', {0x3E, 0x41, 0x41, 0x41, 0x3E}},
	{'P', {0x7F, 0x09, 0x09, 0x09, 0x06}},
	{'Q', {0x3E, 0x41, 0x51, 0x21, 0x5E}},
	{'R', {0x7F, 0x09, 0x19, 0x29, 0x46}},
	{'S', {0x46, 0x49, 0x49, 0x49, 0x31}},
	{'T', {0x01, 0x01, 0x7F, 0x01, 0x01}},
	{'U', {0x3F, 0x40, 0x40, 0x40, 0x3F}},
	{'V', {0x1F, 0x20, 0x40, 0x20, 0x1F}},
	{'W', {0x3F, 0x40, 0x38, 0x40, 0x3F}},
	{'X', {0x63, 0x14, 0x08, 0x14, 0x63}},
	{'Y', {0x07, 0x08, 0x70, 0x08, 0x07}},
	{'Z', {0x61, 0x51, 0x49, 0x45, 0x43}},
};

static const uint8_t *glyph_for(char c)
{
	if (c >= 'a' && c <= 'z') {
		c -= 32; /* fold lowercase to the uppercase glyphs */
	}
	for (size_t i = 0; i < sizeof(FONT) / sizeof(FONT[0]); i++) {
		if (FONT[i].c == c) {
			return FONT[i].col;
		}
	}
	return FONT[0].col; /* space */
}

#define CHAR_W 6 /* 5 px glyph + 1 px gap */
#define CHAR_H 8 /* 7 px glyph + 1 px gap */

static void draw_char(int x, int y, char c)
{
	const uint8_t *g = glyph_for(c);

	for (int col = 0; col < 5; col++) {
		uint8_t bits = g[col];
		for (int row = 0; row < 7; row++) {
			if (bits & (1u << row)) {
				set_black(x + col, y + row);
			}
		}
	}
}

static void draw_str(int x, int y, const char *s)
{
	for (; *s; s++) {
		if (x + CHAR_W > EPD_W) {
			break; /* clip at right edge */
		}
		draw_char(x, y, *s);
		x += CHAR_W;
	}
}

/* Minimal unsigned-decimal formatter (no stdio in this tiny image). */
static void u32_to_dec(uint32_t v, char *out)
{
	char tmp[10];
	int n = 0;

	do {
		tmp[n++] = (char)('0' + (v % 10));
		v /= 10;
	} while (v && n < (int)sizeof(tmp));

	int i = 0;
	while (n > 0) {
		out[i++] = tmp[--n];
	}
	out[i] = '\0';
}

/* Build "<label><uint>" into buf. */
static void draw_kv_u32(int x, int y, const char *label, uint32_t v)
{
	char num[12];

	u32_to_dec(v, num);
	draw_str(x, y, label);
	draw_str(x + (int)strlen(label) * CHAR_W, y, num);
}

void bl_diag_show(const struct bl_diag *d)
{
	if (epd_min_init() < 0) {
		printk("bl: diag: panel init failed\n");
		return;
	}

	memset(fb, 0xFF, sizeof(fb)); /* white background */

	int y = 2;

	draw_str(2, y, "VBX BOOTLOADER");
	y += CHAR_H;
	draw_str(2, y, d->reason ? d->reason : "");
	y += CHAR_H + 2;

	if (d->chosen >= 0) {
		char line[24];

		strcpy(line, d->trial ? "TRIAL SLOT " : "BOOT SLOT ");
		size_t l = strlen(line);
		line[l++] = (char)('A' + d->chosen);
		line[l] = '\0';
		draw_str(2, y, line);
	} else {
		draw_str(2, y, "HALT NO IMAGE");
	}
	y += CHAR_H;

	if (d->have_state) {
		draw_kv_u32(2, y, "STATE SEQ ", d->seq);
	} else {
		draw_str(2, y, "STATE NONE");
	}
	y += CHAR_H + 2;

	for (int s = 0; s < BL_DIAG_NUM_SLOTS; s++) {
		const struct bl_diag_slot *m = &d->slot[s];
		char hdr[8];

		strcpy(hdr, "SLOT ");
		hdr[5] = (char)('A' + s);
		hdr[6] = '\0';
		draw_str(2, y, hdr);
		if (s == d->chosen) {
			draw_str(2 + (int)strlen(hdr) * CHAR_W, y, ">"); /* booted slot */
		}
		y += CHAR_H;

		draw_str(8, y, m->valid ? "VALID" : "NOVALID");
		draw_str(8 + 8 * CHAR_W, y, m->crc_ok ? "CRC OK" : "CRC FAIL");
		y += CHAR_H;

		draw_kv_u32(8, y, "VER ", m->version);
		y += CHAR_H;

		draw_kv_u32(8, y, "LEN ", m->image_len);
		y += CHAR_H;

		draw_kv_u32(8, y, "ATT ", m->attempts);
		draw_str(8 + 8 * CHAR_W, y, m->confirmed ? "CONF" : "UNCONF");
		y += CHAR_H + 2;
	}

	epd_min_show(fb);
}
```

## src/diag.h
```c
#ifndef VBX_BL_DIAG_H
#define VBX_BL_DIAG_H

/*
 * Bootloader on-ePaper diagnostics. The board has no usable serial, so on a
 * trial boot / revert / halt we render the boot decision + per-slot state to the
 * panel via the minimal driver (epd_min). main.c gathers the facts (live CRC,
 * version, bl_state fields) into bl_diag and calls bl_diag_show().
 */

#include <stdbool.h>
#include <stdint.h>

#define BL_DIAG_NUM_SLOTS 2

struct bl_diag_slot {
	bool     valid;     /* bl_state says this slot was OTA-verified */
	bool     crc_ok;    /* live trailer CRC verified this boot */
	bool     confirmed; /* app confirmed a healthy boot */
	uint8_t  attempts;  /* trial boots since last confirm */
	uint32_t version;
	uint32_t image_len;
};

struct bl_diag {
	bool                have_state; /* a valid bl_state record was found */
	uint16_t            seq;        /* bl_state record seq (if have_state) */
	int                 chosen;     /* slot index booted this time, or -1 (halt) */
	bool                trial;      /* chosen slot is an unconfirmed trial */
	const char         *reason;     /* short label, e.g. "TRIAL" / "REVERT" / "HALT" */
	struct bl_diag_slot slot[BL_DIAG_NUM_SLOTS];
};

/* Init the panel (lazily) and full-refresh the diagnostic screen. Best-effort:
 * a missing/stuck panel is silently ignored so it never blocks booting. */
void bl_diag_show(const struct bl_diag *d);

#endif /* VBX_BL_DIAG_H */
```

## src/epd_min.c
```c
/*
 * Minimal GDEY027T91 (SSD1680) driver for the bootloader — see epd_min.h.
 *
 * Ported from the app's peripherals/epd/.../Display_EPD_W21.cpp, keeping only the
 * HW init (SWRESET) and the full-refresh path (RAM 0x24 + update 0x22/0xF7/0x20).
 * GPIO polarity matches the board DTS (dc/reset GPIO_ACTIVE_LOW, busy ACTIVE_HIGH);
 * CS is driven by the Zephyr SPI controller via cs-gpios.
 */

#include "epd_min.h"

#include <zephyr/devicetree.h>
#include <zephyr/drivers/gpio.h>
#include <zephyr/drivers/spi.h>
#include <zephyr/kernel.h>

#define EPD_NODE DT_NODELABEL(epaper)

#if DT_NODE_EXISTS(EPD_NODE)

static const struct gpio_dt_spec dc_gpio   = GPIO_DT_SPEC_GET(EPD_NODE, dc_gpios);
static const struct gpio_dt_spec rst_gpio  = GPIO_DT_SPEC_GET(EPD_NODE, reset_gpios);
static const struct gpio_dt_spec busy_gpio = GPIO_DT_SPEC_GET(EPD_NODE, busy_gpios);

static const struct spi_dt_spec epd_spi =
	SPI_DT_SPEC_GET(EPD_NODE, SPI_OP_MODE_MASTER | SPI_WORD_SET(8), 0);

/* BUSY is ACTIVE_HIGH (1 = busy). Bound the wait so a dead/absent panel can't
 * wedge the bootloader; ~5 s covers a full refresh (typ ~2-4 s). */
#define BUSY_TIMEOUT_MS 6000

static int wait_busy(void)
{
	for (int waited = 0; waited < BUSY_TIMEOUT_MS; waited += 5) {
		if (gpio_pin_get_dt(&busy_gpio) == 0) {
			return 0;
		}
		k_msleep(5);
	}
	return -1; /* stuck busy */
}

static void write_cmd(uint8_t cmd)
{
	gpio_pin_set_dt(&dc_gpio, 1); /* DC active-low -> logical 1 = command */
	const struct spi_buf b = { .buf = &cmd, .len = 1 };
	const struct spi_buf_set set = { .buffers = &b, .count = 1 };
	spi_write_dt(&epd_spi, &set);
}

static void write_data(const uint8_t *data, size_t len)
{
	gpio_pin_set_dt(&dc_gpio, 0); /* logical 0 = data */
	const struct spi_buf b = { .buf = (void *)data, .len = len };
	const struct spi_buf_set set = { .buffers = &b, .count = 1 };
	spi_write_dt(&epd_spi, &set);
}

static void write_data1(uint8_t d)
{
	write_data(&d, 1);
}

int epd_min_init(void)
{
	if (!spi_is_ready_dt(&epd_spi) || !gpio_is_ready_dt(&dc_gpio) ||
	    !gpio_is_ready_dt(&rst_gpio) || !gpio_is_ready_dt(&busy_gpio)) {
		return -1;
	}

	gpio_pin_configure_dt(&dc_gpio, GPIO_OUTPUT_INACTIVE);
	gpio_pin_configure_dt(&rst_gpio, GPIO_OUTPUT_INACTIVE);
	gpio_pin_configure_dt(&busy_gpio, GPIO_INPUT);

	/* Hardware reset (RST active-low: logical 1 = asserted). */
	gpio_pin_set_dt(&rst_gpio, 1);
	k_msleep(10);
	gpio_pin_set_dt(&rst_gpio, 0);
	k_msleep(10);

	if (wait_busy() < 0) {
		return -1;
	}
	write_cmd(0x12); /* SWRESET */
	if (wait_busy() < 0) {
		return -1;
	}
	return 0;
}

int epd_min_show(const uint8_t *fb)
{
	write_cmd(0x24); /* write B/W RAM (bit 1 = white) */
	write_data(fb, EPD_MIN_FB_SIZE);

	write_cmd(0x22); /* display update control */
	write_data1(0xF7);
	write_cmd(0x20); /* activate update sequence */
	return wait_busy();
}

#else /* !DT_NODE_EXISTS(EPD_NODE) */

int epd_min_init(void) { return -1; }
int epd_min_show(const uint8_t *fb) { (void)fb; return -1; }

#endif
```

## src/epd_min.h
```c
#ifndef VBX_BL_EPD_MIN_H
#define VBX_BL_EPD_MIN_H

/*
 * Minimal, self-contained GDEY027T91 (SSD1680) driver for the bootloader.
 *
 * The app has a full C++ ePaper + GUI_Paint stack, but that won't fit in the
 * 48 KB bootloader_partition. This is a stripped C driver: GPIO + SPI from the
 * same board DT nodes (epaper / spi00), HW init, and a single full-refresh of a
 * 5808-byte 1bpp framebuffer. Used only to draw a boot diagnostic screen.
 */

#include <stdint.h>

#define EPD_MIN_FB_SIZE 5808 /* 176x264 1bpp: 264 rows * 22 bytes */

/* Reset + init the panel. Returns 0 on success, <0 if SPI/GPIO not ready or the
 * BUSY line never clears (stuck panel). */
int epd_min_init(void);

/* Full-refresh the panel with fb[EPD_MIN_FB_SIZE] (bit 1 = white). Returns 0, or
 * <0 if BUSY times out. Call epd_min_init() first. */
int epd_min_show(const uint8_t *fb);

#endif /* VBX_BL_EPD_MIN_H */
```
