## firmware/vibamix/boards/pants_for_birds/vibamix_xiao/Kconfig.vibamix_xiao
```kconfig
config BOARD_VIBAMIX_XIAO
	select SOC_NRF54L15_CPUAPP if BOARD_VIBAMIX_XIAO_NRF54L15_CPUAPP
	select SOC_NRF54L15_CPUFLPR if \
		BOARD_VIBAMIX_XIAO_NRF54L15_CPUFLPR || \
		BOARD_VIBAMIX_XIAO_NRF54L15_CPUFLPR_XIP
```

## firmware/vibamix/boards/pants_for_birds/vibamix_xiao/board.yml
```yaml
board:
  name: vibamix_xiao
  full_name: vibamix_xiao
  vendor: pants_for_birds
  socs:
  - name: nrf54l15
    variants:
    - name: xip
      cpucluster: cpuflpr

runners:
  run_once:
    '--recover':
      - runners:
          - nrfjprog
          - nrfutil
        run: first
        groups:
          - boards:
              - vibamix_xiao/nrf54l15/cpuapp
              - vibamix_xiao/nrf54l15/cpuflpr
              - vibamix_xiao/nrf54l15/cpuflpr/xip
    '--erase':
      - runners:
          - nrfjprog
          - jlink
          - nrfutil
        run: first
        groups:
          - boards:
              - vibamix_xiao/nrf54l15/cpuapp
              - vibamix_xiao/nrf54l15/cpuflpr
              - vibamix_xiao/nrf54l15/cpuflpr/xip
    '--reset':
      - runners:
          - nrfjprog
          - jlink
          - nrfutil
        run: last
        groups:
          - boards:
              - vibamix_xiao/nrf54l15/cpuapp
              - vibamix_xiao/nrf54l15/cpuflpr
              - vibamix_xiao/nrf54l15/cpuflpr/xip
```
