#include "vibamix_xiao_nrf54l15_cpuflpr.dts"

/ {
	compatible = "pants_for_birds,vibamix-xiao-cpuflpr-xip";
};

&cpuflpr_sram {
	reg = <0x2002f000 DT_SIZE_K(68)>;
	ranges = <0x0 0x2002f000 DT_SIZE_K(68)>;
};
